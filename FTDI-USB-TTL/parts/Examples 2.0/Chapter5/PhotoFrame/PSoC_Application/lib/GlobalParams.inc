; Generated by PSoC Designer ver 4.3  b1884 : 23 June, 2006
;
;=============================================================================
;  FILENAME:   GlobalParams.inc
;  DATE:       2 August 2004
;
;  DESCRIPTION:
;  Constants describing many of the global parameter settings.
;  This file contains equates to support oscillator register initialization
;  for the CY8C24123B
;
;  Copyright (C) Cypress MicroSystems 2000-2004. All rights reserved.
;
; NOTES:
; Do not modify this file. It is generated by PSoC Designer each time the
; generate application function is run. The values of the parameters in this
; file can be modified by changing the values of the global parameters in the
; device editor.
;=============================================================================
;

CPU_CLOCK:				equ	3h	;CPU clock value
CPU_CLOCK_MASK:			equ	7h	;CPU clock mask
CPU_CLOCK_JUST:			equ	3h	;CPU clock value justified
SELECT_32K:				equ	0h	;32K select value
SELECT_32K_MASK:		equ	80h	;32K select mask
SELECT_32K_JUST:		equ	0h	;32K select value justified
PLL_MODE:				equ	0h	;PLL mode value
PLL_MODE_MASK:			equ	40h	;PLL mode mask
PLL_MODE_JUST:			equ	0h	;PLL mode value justified
SLEEP_TIMER:			equ	0h	;Sleep Timer value
SLEEP_TIMER_MASK:		equ	18h	;Sleep Timer mask
SLEEP_TIMER_JUST:		equ	0h	;Sleep Timer value justified
SWITCH_MODE_PUMP:		equ	1h	;Switch Mode Pump setting
SWITCH_MODE_PUMP_MASK:	equ	80h	;Switch Mode Pump mask
SWITCH_MODE_PUMP_JUST:	equ	80h	;Switch Mode Pump justified
LVD_TBEN:               equ 0   ; Low Voltage Throttle-back enable value
LVD_TBEN_MASK:          equ 8  ; Low Voltage Throttle-back enable mask
LVD_TBEN_JUST:          equ 0  ; Low Voltage Throttle-back enable justified
TRIP_VOLTAGE:			equ	7h   ;Trip Voltage value
TRIP_VOLTAGE_MASK:      equ 7h  ;Trip Voltage mask
TRIP_VOLTAGE_JUST:      equ 7h  ;Trip Voltage justified
                              
POWER_SETTING:			equ	10h
POWER_SET_5V0:          equ 10h  ; MASK for 5.0V operation, fast and slow 
POWER_SET_5V0_24MHZ:    equ 10h  ; Power Setting value for 5.0V fast      
POWER_SET_5V0_6MHZ:     equ 11h  ; Power Setting value for 5.0V slow      
POWER_SET_3V3:          equ 08h  ; MASK for 3.3V operation, fast and slow 
POWER_SET_3V3_24MHZ:    equ 08h	 ; Power Setting value for 3.3V fast      
POWER_SET_3V3_6MHZ:     equ 09h	 ; Power Setting value for 3.3V slow      
POWER_SET_2V7:          equ 06h  ; MASK for 2.7V operation, fast and slow
POWER_SET_2V7_12MHZ:    equ 04h	 ; MASK for 2.7V, 12MHZ operation
POWER_SET_2V7_6MHZ:     equ 02h	 ; MASK for 2.7V,  6MHZ operation
POWER_SET_SLOW_IMO:     equ 01h  ; MASK for slow Internal Main Oscillator (IMO) 

COMM_RX_PRESENT:		equ	1	;1 = TRUE
WATCHDOG_ENABLE:		equ 0	;Watchdog Enable 1 = Enable

CLOCK_DIV_VC1:			equ	bh	;VC1 clock divider
CLOCK_DIV_VC1_MASK:		equ	f0h	;VC1 clock divider mask
CLOCK_DIV_VC1_JUST:		equ	b0h	;VC1 clock divider justified
CLOCK_DIV_VC2:			equ	1h	;VC2 clock divider
CLOCK_DIV_VC2_MASK:		equ	fh	;VC2 clock divider mask
CLOCK_DIV_VC2_JUST:		equ	1h	;VC2 clock divider justified
CLOCK_INPUT_VC3:		equ	1h	;VC3 clock source
CLOCK_INPUT_VC3_MASK:	equ	3h	;VC3 clock source mask
CLOCK_INPUT_VC3_JUST:	equ	1h	;VC3 clock source justified
CLOCK_DIV_VC3:			equ	19h	;VC3 clock divider
CLOCK_DIV_VC3_MASK:		equ	ffh	;VC3 clock divider mask
CLOCK_DIV_VC3_JUST:		equ	19h	;VC3 clock divider justified
ANALOG_BUFFER_PWR:		equ	0h	;Analog buffer power level
ANALOG_BUFFER_PWR_MASK:	equ	1h	;Analog buffer power level mask
ANALOG_BUFFER_PWR_JUST:	equ	0h	;Analog buffer power level justified
ANALOG_POWER:			equ	5h	;Analog power control
ANALOG_POWER_MASK:		equ	7h	;Analog power control mask
ANALOG_POWER_JUST:		equ	5h	;Analog power control justified
OP_AMP_BIAS:			equ	0h	;Op amp bias level
OP_AMP_BIAS_MASK:		equ	40h	;Op amp bias level mask
OP_AMP_BIAS_JUST:		equ	0h	;Op amp bias level justified
REF_MUX:				equ	0h	;Ref mux setting
REF_MUX_MASK:			equ	38h	;Ref mux setting mask
REF_MUX_JUST:			equ	0h	;Ref mux setting justified
AGND_BYPASS:			equ	0h	;AGndBypass setting
AGND_BYPASS_MASK:		equ	40h	;AGndBypass setting mask
AGND_BYPASS_JUST:		equ	0h	;AGndBypass setting justified
SYSCLK_SOURCE:				equ	(0h | 0h)	;SysClk Source setting
SYSCLK_SOURCE_MASK:			equ	(4h | 2h)	;SysClk Source setting mask
SYSCLK_SOURCE_JUST:			equ	(0h | 0h)	;SysClk Source setting justified
SYSCLK_2_DISABLE:				equ	0h	;SysClk*2 Disable setting
SYSCLK_2_DISABLE_MASK:			equ	1h	;SysClk*2 Disable setting mask
SYSCLK_2_DISABLE_JUST:			equ	0h	;SysClk*2 Disable setting justified
;
; register initial values
;
ANALOG_IO_CONTROL:		equ 0h	;Analog IO Control register (ABF_CR)
PORT_0_GLOBAL_SELECT:	equ 3ch	;Port 0 global select register (PRT0GS)
PORT_0_DRIVE_0:			equ ch	;Port 0 drive mode 0 register (PRT0DM0)
PORT_0_DRIVE_1:			equ 30h	;Port 0 drive mode 1 register (PRT0DM1)
PORT_0_DRIVE_2:			equ 0h	;Port 0 drive mode 2 register (PRT0DM2)
PORT_0_INTENABLE:		equ 0h	;Port 0 interrupt enable register (PRT0IE)
PORT_0_INTCTRL_0:		equ 0h	;Port 0 interrupt control 0 register (PRT0IC0)
PORT_0_INTCTRL_1:		equ 0h	;Port 0 interrupt control 1 register (PRT0IC1)
PORT_1_GLOBAL_SELECT:	equ 0h	;Port 1 global select register (PRT1GS)
PORT_1_DRIVE_0:			equ 3h	;Port 1 drive mode 0 register (PRT1DM0)
PORT_1_DRIVE_1:			equ 0h	;Port 1 drive mode 1 register (PRT1DM1)
PORT_1_DRIVE_2:			equ 0h	;Port 1 drive mode 2 register (PRT1DM2)
PORT_1_INTENABLE:		equ 0h	;Port 1 interrupt enable register (PRT1IE)
PORT_1_INTCTRL_0:		equ 0h	;Port 1 interrupt control 0 register (PRT1IC0)
PORT_1_INTCTRL_1:		equ 0h	;Port 1 interrupt control 1 register (PRT1IC1)
PORT_2_GLOBAL_SELECT:	equ 0h	;Port 2 global select register (PRT2GS)
PORT_2_DRIVE_0:			equ 0h	;Port 2 drive mode 0 register (PRT2DM0)
PORT_2_DRIVE_1:			equ 0h	;Port 2 drive mode 1 register (PRT2DM1)
PORT_2_DRIVE_2:			equ 0h	;Port 2 drive mode 2 register (PRT2DM2)
PORT_2_INTENABLE:		equ 0h	;Port 2 interrupt enable register (PRT2IE)
PORT_2_INTCTRL_0:		equ 0h	;Port 2 interrupt control 0 register (PRT2IC0)
PORT_2_INTCTRL_1:		equ 0h	;Port 2 interrupt control 1 register (PRT2IC1)

; end of file GlobalParams.inc

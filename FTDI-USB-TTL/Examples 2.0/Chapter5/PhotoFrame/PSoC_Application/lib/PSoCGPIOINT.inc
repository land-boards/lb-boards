; Generated by PSoC Designer ver 4.3  b1884 : 23 June, 2006
;
; D_TX address and mask equates
D_TX_Data_ADDR:	equ	0h
D_TX_DriveMode_0_ADDR:	equ	100h
D_TX_DriveMode_1_ADDR:	equ	101h
D_TX_DriveMode_2_ADDR:	equ	3h
D_TX_GlobalSelect_ADDR:	equ	2h
D_TX_IntCtrl_0_ADDR:	equ	102h
D_TX_IntCtrl_1_ADDR:	equ	103h
D_TX_IntEn_ADDR:	equ	1h
D_TX_MASK:	equ	4h
; V_TX address and mask equates
V_TX_Data_ADDR:	equ	0h
V_TX_DriveMode_0_ADDR:	equ	100h
V_TX_DriveMode_1_ADDR:	equ	101h
V_TX_DriveMode_2_ADDR:	equ	3h
V_TX_GlobalSelect_ADDR:	equ	2h
V_TX_IntCtrl_0_ADDR:	equ	102h
V_TX_IntCtrl_1_ADDR:	equ	103h
V_TX_IntEn_ADDR:	equ	1h
V_TX_MASK:	equ	8h
; D_RX address and mask equates
D_RX_Data_ADDR:	equ	0h
D_RX_DriveMode_0_ADDR:	equ	100h
D_RX_DriveMode_1_ADDR:	equ	101h
D_RX_DriveMode_2_ADDR:	equ	3h
D_RX_GlobalSelect_ADDR:	equ	2h
D_RX_IntCtrl_0_ADDR:	equ	102h
D_RX_IntCtrl_1_ADDR:	equ	103h
D_RX_IntEn_ADDR:	equ	1h
D_RX_MASK:	equ	10h
; V_RX address and mask equates
V_RX_Data_ADDR:	equ	0h
V_RX_DriveMode_0_ADDR:	equ	100h
V_RX_DriveMode_1_ADDR:	equ	101h
V_RX_DriveMode_2_ADDR:	equ	3h
V_RX_GlobalSelect_ADDR:	equ	2h
V_RX_IntCtrl_0_ADDR:	equ	102h
V_RX_IntCtrl_1_ADDR:	equ	103h
V_RX_IntEn_ADDR:	equ	1h
V_RX_MASK:	equ	20h

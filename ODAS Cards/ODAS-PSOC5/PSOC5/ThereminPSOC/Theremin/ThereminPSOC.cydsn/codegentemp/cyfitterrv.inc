    IF :LNOT::DEF:INCLUDED_CYFITTERRV_INC
INCLUDED_CYFITTERRV_INC EQU 1
    GET cydevicerv.inc
    GET cydevicerv_trm.inc

; Pin_1
Pin_1__0__INTTYPE EQU CYREG_PICU3_INTTYPE3
Pin_1__0__MASK EQU 0x08
Pin_1__0__PC EQU CYREG_PRT3_PC3
Pin_1__0__PORT EQU 3
Pin_1__0__SHIFT EQU 3
Pin_1__AG EQU CYREG_PRT3_AG
Pin_1__AMUX EQU CYREG_PRT3_AMUX
Pin_1__BIE EQU CYREG_PRT3_BIE
Pin_1__BIT_MASK EQU CYREG_PRT3_BIT_MASK
Pin_1__BYP EQU CYREG_PRT3_BYP
Pin_1__CTL EQU CYREG_PRT3_CTL
Pin_1__DM0 EQU CYREG_PRT3_DM0
Pin_1__DM1 EQU CYREG_PRT3_DM1
Pin_1__DM2 EQU CYREG_PRT3_DM2
Pin_1__DR EQU CYREG_PRT3_DR
Pin_1__INP_DIS EQU CYREG_PRT3_INP_DIS
Pin_1__INTTYPE_BASE EQU CYDEV_PICU_INTTYPE_PICU3_BASE
Pin_1__LCD_COM_SEG EQU CYREG_PRT3_LCD_COM_SEG
Pin_1__LCD_EN EQU CYREG_PRT3_LCD_EN
Pin_1__MASK EQU 0x08
Pin_1__PORT EQU 3
Pin_1__PRT EQU CYREG_PRT3_PRT
Pin_1__PRTDSI__CAPS_SEL EQU CYREG_PRT3_CAPS_SEL
Pin_1__PRTDSI__DBL_SYNC_IN EQU CYREG_PRT3_DBL_SYNC_IN
Pin_1__PRTDSI__OE_SEL0 EQU CYREG_PRT3_OE_SEL0
Pin_1__PRTDSI__OE_SEL1 EQU CYREG_PRT3_OE_SEL1
Pin_1__PRTDSI__OUT_SEL0 EQU CYREG_PRT3_OUT_SEL0
Pin_1__PRTDSI__OUT_SEL1 EQU CYREG_PRT3_OUT_SEL1
Pin_1__PRTDSI__SYNC_OUT EQU CYREG_PRT3_SYNC_OUT
Pin_1__PS EQU CYREG_PRT3_PS
Pin_1__SHIFT EQU 3
Pin_1__SLW EQU CYREG_PRT3_SLW

; Pin_2
Pin_2__0__INTTYPE EQU CYREG_PICU0_INTTYPE2
Pin_2__0__MASK EQU 0x04
Pin_2__0__PC EQU CYREG_PRT0_PC2
Pin_2__0__PORT EQU 0
Pin_2__0__SHIFT EQU 2
Pin_2__AG EQU CYREG_PRT0_AG
Pin_2__AMUX EQU CYREG_PRT0_AMUX
Pin_2__BIE EQU CYREG_PRT0_BIE
Pin_2__BIT_MASK EQU CYREG_PRT0_BIT_MASK
Pin_2__BYP EQU CYREG_PRT0_BYP
Pin_2__CTL EQU CYREG_PRT0_CTL
Pin_2__DM0 EQU CYREG_PRT0_DM0
Pin_2__DM1 EQU CYREG_PRT0_DM1
Pin_2__DM2 EQU CYREG_PRT0_DM2
Pin_2__DR EQU CYREG_PRT0_DR
Pin_2__INP_DIS EQU CYREG_PRT0_INP_DIS
Pin_2__INTTYPE_BASE EQU CYDEV_PICU_INTTYPE_PICU0_BASE
Pin_2__LCD_COM_SEG EQU CYREG_PRT0_LCD_COM_SEG
Pin_2__LCD_EN EQU CYREG_PRT0_LCD_EN
Pin_2__MASK EQU 0x04
Pin_2__PORT EQU 0
Pin_2__PRT EQU CYREG_PRT0_PRT
Pin_2__PRTDSI__CAPS_SEL EQU CYREG_PRT0_CAPS_SEL
Pin_2__PRTDSI__DBL_SYNC_IN EQU CYREG_PRT0_DBL_SYNC_IN
Pin_2__PRTDSI__OE_SEL0 EQU CYREG_PRT0_OE_SEL0
Pin_2__PRTDSI__OE_SEL1 EQU CYREG_PRT0_OE_SEL1
Pin_2__PRTDSI__OUT_SEL0 EQU CYREG_PRT0_OUT_SEL0
Pin_2__PRTDSI__OUT_SEL1 EQU CYREG_PRT0_OUT_SEL1
Pin_2__PRTDSI__SYNC_OUT EQU CYREG_PRT0_SYNC_OUT
Pin_2__PS EQU CYREG_PRT0_PS
Pin_2__SHIFT EQU 2
Pin_2__SLW EQU CYREG_PRT0_SLW

; Vout_1
Vout_1__0__INTTYPE EQU CYREG_PICU3_INTTYPE6
Vout_1__0__MASK EQU 0x40
Vout_1__0__PC EQU CYREG_PRT3_PC6
Vout_1__0__PORT EQU 3
Vout_1__0__SHIFT EQU 6
Vout_1__AG EQU CYREG_PRT3_AG
Vout_1__AMUX EQU CYREG_PRT3_AMUX
Vout_1__BIE EQU CYREG_PRT3_BIE
Vout_1__BIT_MASK EQU CYREG_PRT3_BIT_MASK
Vout_1__BYP EQU CYREG_PRT3_BYP
Vout_1__CTL EQU CYREG_PRT3_CTL
Vout_1__DM0 EQU CYREG_PRT3_DM0
Vout_1__DM1 EQU CYREG_PRT3_DM1
Vout_1__DM2 EQU CYREG_PRT3_DM2
Vout_1__DR EQU CYREG_PRT3_DR
Vout_1__INP_DIS EQU CYREG_PRT3_INP_DIS
Vout_1__INTTYPE_BASE EQU CYDEV_PICU_INTTYPE_PICU3_BASE
Vout_1__LCD_COM_SEG EQU CYREG_PRT3_LCD_COM_SEG
Vout_1__LCD_EN EQU CYREG_PRT3_LCD_EN
Vout_1__MASK EQU 0x40
Vout_1__PORT EQU 3
Vout_1__PRT EQU CYREG_PRT3_PRT
Vout_1__PRTDSI__CAPS_SEL EQU CYREG_PRT3_CAPS_SEL
Vout_1__PRTDSI__DBL_SYNC_IN EQU CYREG_PRT3_DBL_SYNC_IN
Vout_1__PRTDSI__OE_SEL0 EQU CYREG_PRT3_OE_SEL0
Vout_1__PRTDSI__OE_SEL1 EQU CYREG_PRT3_OE_SEL1
Vout_1__PRTDSI__OUT_SEL0 EQU CYREG_PRT3_OUT_SEL0
Vout_1__PRTDSI__OUT_SEL1 EQU CYREG_PRT3_OUT_SEL1
Vout_1__PRTDSI__SYNC_OUT EQU CYREG_PRT3_SYNC_OUT
Vout_1__PS EQU CYREG_PRT3_PS
Vout_1__SHIFT EQU 6
Vout_1__SLW EQU CYREG_PRT3_SLW

; Opamp_1_ABuf
Opamp_1_ABuf__CR EQU CYREG_OPAMP3_CR
Opamp_1_ABuf__MX EQU CYREG_OPAMP3_MX
Opamp_1_ABuf__NPUMP_OPAMP_TR0 EQU CYREG_NPUMP_OPAMP_TR0
Opamp_1_ABuf__PM_ACT_CFG EQU CYREG_PM_ACT_CFG4
Opamp_1_ABuf__PM_ACT_MSK EQU 0x08
Opamp_1_ABuf__PM_STBY_CFG EQU CYREG_PM_STBY_CFG4
Opamp_1_ABuf__PM_STBY_MSK EQU 0x08
Opamp_1_ABuf__RSVD EQU CYREG_OPAMP3_RSVD
Opamp_1_ABuf__SW EQU CYREG_OPAMP3_SW
Opamp_1_ABuf__TR0 EQU CYREG_OPAMP3_TR0
Opamp_1_ABuf__TR1 EQU CYREG_OPAMP3_TR1

; Opamp_2_ABuf
Opamp_2_ABuf__CR EQU CYREG_OPAMP0_CR
Opamp_2_ABuf__MX EQU CYREG_OPAMP0_MX
Opamp_2_ABuf__NPUMP_OPAMP_TR0 EQU CYREG_NPUMP_OPAMP_TR0
Opamp_2_ABuf__PM_ACT_CFG EQU CYREG_PM_ACT_CFG4
Opamp_2_ABuf__PM_ACT_MSK EQU 0x01
Opamp_2_ABuf__PM_STBY_CFG EQU CYREG_PM_STBY_CFG4
Opamp_2_ABuf__PM_STBY_MSK EQU 0x01
Opamp_2_ABuf__RSVD EQU CYREG_OPAMP0_RSVD
Opamp_2_ABuf__SW EQU CYREG_OPAMP0_SW
Opamp_2_ABuf__TR0 EQU CYREG_OPAMP0_TR0
Opamp_2_ABuf__TR1 EQU CYREG_OPAMP0_TR1

; Opamp_3_ABuf
Opamp_3_ABuf__CR EQU CYREG_OPAMP1_CR
Opamp_3_ABuf__MX EQU CYREG_OPAMP1_MX
Opamp_3_ABuf__NPUMP_OPAMP_TR0 EQU CYREG_NPUMP_OPAMP_TR0
Opamp_3_ABuf__PM_ACT_CFG EQU CYREG_PM_ACT_CFG4
Opamp_3_ABuf__PM_ACT_MSK EQU 0x02
Opamp_3_ABuf__PM_STBY_CFG EQU CYREG_PM_STBY_CFG4
Opamp_3_ABuf__PM_STBY_MSK EQU 0x02
Opamp_3_ABuf__RSVD EQU CYREG_OPAMP1_RSVD
Opamp_3_ABuf__SW EQU CYREG_OPAMP1_SW
Opamp_3_ABuf__TR0 EQU CYREG_OPAMP1_TR0
Opamp_3_ABuf__TR1 EQU CYREG_OPAMP1_TR1

; ADC_SAR_1_ADC_SAR
ADC_SAR_1_ADC_SAR__CLK EQU CYREG_SAR0_CLK
ADC_SAR_1_ADC_SAR__CSR0 EQU CYREG_SAR0_CSR0
ADC_SAR_1_ADC_SAR__CSR1 EQU CYREG_SAR0_CSR1
ADC_SAR_1_ADC_SAR__CSR2 EQU CYREG_SAR0_CSR2
ADC_SAR_1_ADC_SAR__CSR3 EQU CYREG_SAR0_CSR3
ADC_SAR_1_ADC_SAR__CSR4 EQU CYREG_SAR0_CSR4
ADC_SAR_1_ADC_SAR__CSR5 EQU CYREG_SAR0_CSR5
ADC_SAR_1_ADC_SAR__CSR6 EQU CYREG_SAR0_CSR6
ADC_SAR_1_ADC_SAR__PM_ACT_CFG EQU CYREG_PM_ACT_CFG11
ADC_SAR_1_ADC_SAR__PM_ACT_MSK EQU 0x01
ADC_SAR_1_ADC_SAR__PM_STBY_CFG EQU CYREG_PM_STBY_CFG11
ADC_SAR_1_ADC_SAR__PM_STBY_MSK EQU 0x01
ADC_SAR_1_ADC_SAR__SW0 EQU CYREG_SAR0_SW0
ADC_SAR_1_ADC_SAR__SW2 EQU CYREG_SAR0_SW2
ADC_SAR_1_ADC_SAR__SW3 EQU CYREG_SAR0_SW3
ADC_SAR_1_ADC_SAR__SW4 EQU CYREG_SAR0_SW4
ADC_SAR_1_ADC_SAR__SW6 EQU CYREG_SAR0_SW6
ADC_SAR_1_ADC_SAR__TR0 EQU CYREG_SAR0_TR0
ADC_SAR_1_ADC_SAR__WRK0 EQU CYREG_SAR0_WRK0
ADC_SAR_1_ADC_SAR__WRK1 EQU CYREG_SAR0_WRK1

; ADC_SAR_1_Bypass
ADC_SAR_1_Bypass__0__INTTYPE EQU CYREG_PICU0_INTTYPE4
ADC_SAR_1_Bypass__0__MASK EQU 0x10
ADC_SAR_1_Bypass__0__PC EQU CYREG_PRT0_PC4
ADC_SAR_1_Bypass__0__PORT EQU 0
ADC_SAR_1_Bypass__0__SHIFT EQU 4
ADC_SAR_1_Bypass__AG EQU CYREG_PRT0_AG
ADC_SAR_1_Bypass__AMUX EQU CYREG_PRT0_AMUX
ADC_SAR_1_Bypass__BIE EQU CYREG_PRT0_BIE
ADC_SAR_1_Bypass__BIT_MASK EQU CYREG_PRT0_BIT_MASK
ADC_SAR_1_Bypass__BYP EQU CYREG_PRT0_BYP
ADC_SAR_1_Bypass__CTL EQU CYREG_PRT0_CTL
ADC_SAR_1_Bypass__DM0 EQU CYREG_PRT0_DM0
ADC_SAR_1_Bypass__DM1 EQU CYREG_PRT0_DM1
ADC_SAR_1_Bypass__DM2 EQU CYREG_PRT0_DM2
ADC_SAR_1_Bypass__DR EQU CYREG_PRT0_DR
ADC_SAR_1_Bypass__INP_DIS EQU CYREG_PRT0_INP_DIS
ADC_SAR_1_Bypass__INTTYPE_BASE EQU CYDEV_PICU_INTTYPE_PICU0_BASE
ADC_SAR_1_Bypass__LCD_COM_SEG EQU CYREG_PRT0_LCD_COM_SEG
ADC_SAR_1_Bypass__LCD_EN EQU CYREG_PRT0_LCD_EN
ADC_SAR_1_Bypass__MASK EQU 0x10
ADC_SAR_1_Bypass__PORT EQU 0
ADC_SAR_1_Bypass__PRT EQU CYREG_PRT0_PRT
ADC_SAR_1_Bypass__PRTDSI__CAPS_SEL EQU CYREG_PRT0_CAPS_SEL
ADC_SAR_1_Bypass__PRTDSI__DBL_SYNC_IN EQU CYREG_PRT0_DBL_SYNC_IN
ADC_SAR_1_Bypass__PRTDSI__OE_SEL0 EQU CYREG_PRT0_OE_SEL0
ADC_SAR_1_Bypass__PRTDSI__OE_SEL1 EQU CYREG_PRT0_OE_SEL1
ADC_SAR_1_Bypass__PRTDSI__OUT_SEL0 EQU CYREG_PRT0_OUT_SEL0
ADC_SAR_1_Bypass__PRTDSI__OUT_SEL1 EQU CYREG_PRT0_OUT_SEL1
ADC_SAR_1_Bypass__PRTDSI__SYNC_OUT EQU CYREG_PRT0_SYNC_OUT
ADC_SAR_1_Bypass__PS EQU CYREG_PRT0_PS
ADC_SAR_1_Bypass__SHIFT EQU 4
ADC_SAR_1_Bypass__SLW EQU CYREG_PRT0_SLW

; ADC_SAR_1_IRQ
ADC_SAR_1_IRQ__INTC_CLR_EN_REG EQU CYREG_NVIC_CLRENA0
ADC_SAR_1_IRQ__INTC_CLR_PD_REG EQU CYREG_NVIC_CLRPEND0
ADC_SAR_1_IRQ__INTC_MASK EQU 0x01
ADC_SAR_1_IRQ__INTC_NUMBER EQU 0
ADC_SAR_1_IRQ__INTC_PRIOR_NUM EQU 7
ADC_SAR_1_IRQ__INTC_PRIOR_REG EQU CYREG_NVIC_PRI_0
ADC_SAR_1_IRQ__INTC_SET_EN_REG EQU CYREG_NVIC_SETENA0
ADC_SAR_1_IRQ__INTC_SET_PD_REG EQU CYREG_NVIC_SETPEND0

; ADC_SAR_1_theACLK
ADC_SAR_1_theACLK__CFG0 EQU CYREG_CLKDIST_DCFG0_CFG0
ADC_SAR_1_theACLK__CFG1 EQU CYREG_CLKDIST_DCFG0_CFG1
ADC_SAR_1_theACLK__CFG2 EQU CYREG_CLKDIST_DCFG0_CFG2
ADC_SAR_1_theACLK__CFG2_SRC_SEL_MASK EQU 0x07
ADC_SAR_1_theACLK__INDEX EQU 0x00
ADC_SAR_1_theACLK__PM_ACT_CFG EQU CYREG_PM_ACT_CFG2
ADC_SAR_1_theACLK__PM_ACT_MSK EQU 0x01
ADC_SAR_1_theACLK__PM_STBY_CFG EQU CYREG_PM_STBY_CFG2
ADC_SAR_1_theACLK__PM_STBY_MSK EQU 0x01

; WaveDAC8_1_DacClk
WaveDAC8_1_DacClk__CFG0 EQU CYREG_CLKDIST_DCFG1_CFG0
WaveDAC8_1_DacClk__CFG1 EQU CYREG_CLKDIST_DCFG1_CFG1
WaveDAC8_1_DacClk__CFG2 EQU CYREG_CLKDIST_DCFG1_CFG2
WaveDAC8_1_DacClk__CFG2_SRC_SEL_MASK EQU 0x07
WaveDAC8_1_DacClk__INDEX EQU 0x01
WaveDAC8_1_DacClk__PM_ACT_CFG EQU CYREG_PM_ACT_CFG2
WaveDAC8_1_DacClk__PM_ACT_MSK EQU 0x02
WaveDAC8_1_DacClk__PM_STBY_CFG EQU CYREG_PM_STBY_CFG2
WaveDAC8_1_DacClk__PM_STBY_MSK EQU 0x02

; WaveDAC8_1_VDAC8_viDAC8
WaveDAC8_1_VDAC8_viDAC8__CR0 EQU CYREG_DAC3_CR0
WaveDAC8_1_VDAC8_viDAC8__CR1 EQU CYREG_DAC3_CR1
WaveDAC8_1_VDAC8_viDAC8__D EQU CYREG_DAC3_D
WaveDAC8_1_VDAC8_viDAC8__PM_ACT_CFG EQU CYREG_PM_ACT_CFG8
WaveDAC8_1_VDAC8_viDAC8__PM_ACT_MSK EQU 0x08
WaveDAC8_1_VDAC8_viDAC8__PM_STBY_CFG EQU CYREG_PM_STBY_CFG8
WaveDAC8_1_VDAC8_viDAC8__PM_STBY_MSK EQU 0x08
WaveDAC8_1_VDAC8_viDAC8__STROBE EQU CYREG_DAC3_STROBE
WaveDAC8_1_VDAC8_viDAC8__SW0 EQU CYREG_DAC3_SW0
WaveDAC8_1_VDAC8_viDAC8__SW2 EQU CYREG_DAC3_SW2
WaveDAC8_1_VDAC8_viDAC8__SW3 EQU CYREG_DAC3_SW3
WaveDAC8_1_VDAC8_viDAC8__SW4 EQU CYREG_DAC3_SW4
WaveDAC8_1_VDAC8_viDAC8__TR EQU CYREG_DAC3_TR
WaveDAC8_1_VDAC8_viDAC8__TRIM__M1 EQU CYREG_FLSHID_CUST_TABLES_DAC3_M1
WaveDAC8_1_VDAC8_viDAC8__TRIM__M2 EQU CYREG_FLSHID_CUST_TABLES_DAC3_M2
WaveDAC8_1_VDAC8_viDAC8__TRIM__M3 EQU CYREG_FLSHID_CUST_TABLES_DAC3_M3
WaveDAC8_1_VDAC8_viDAC8__TRIM__M4 EQU CYREG_FLSHID_CUST_TABLES_DAC3_M4
WaveDAC8_1_VDAC8_viDAC8__TRIM__M5 EQU CYREG_FLSHID_CUST_TABLES_DAC3_M5
WaveDAC8_1_VDAC8_viDAC8__TRIM__M6 EQU CYREG_FLSHID_CUST_TABLES_DAC3_M6
WaveDAC8_1_VDAC8_viDAC8__TRIM__M7 EQU CYREG_FLSHID_CUST_TABLES_DAC3_M7
WaveDAC8_1_VDAC8_viDAC8__TRIM__M8 EQU CYREG_FLSHID_CUST_TABLES_DAC3_M8
WaveDAC8_1_VDAC8_viDAC8__TST EQU CYREG_DAC3_TST

; WaveDAC8_1_Wave1_DMA
WaveDAC8_1_Wave1_DMA__DRQ_CTL EQU CYREG_IDMUX_DRQ_CTL0
WaveDAC8_1_Wave1_DMA__DRQ_NUMBER EQU 0
WaveDAC8_1_Wave1_DMA__NUMBEROF_TDS EQU 0
WaveDAC8_1_Wave1_DMA__PRIORITY EQU 2
WaveDAC8_1_Wave1_DMA__TERMIN_EN EQU 0
WaveDAC8_1_Wave1_DMA__TERMIN_SEL EQU 0
WaveDAC8_1_Wave1_DMA__TERMOUT0_EN EQU 0
WaveDAC8_1_Wave1_DMA__TERMOUT0_SEL EQU 0
WaveDAC8_1_Wave1_DMA__TERMOUT1_EN EQU 0
WaveDAC8_1_Wave1_DMA__TERMOUT1_SEL EQU 0

; WaveDAC8_1_Wave2_DMA
WaveDAC8_1_Wave2_DMA__DRQ_CTL EQU CYREG_IDMUX_DRQ_CTL0
WaveDAC8_1_Wave2_DMA__DRQ_NUMBER EQU 1
WaveDAC8_1_Wave2_DMA__NUMBEROF_TDS EQU 0
WaveDAC8_1_Wave2_DMA__PRIORITY EQU 2
WaveDAC8_1_Wave2_DMA__TERMIN_EN EQU 0
WaveDAC8_1_Wave2_DMA__TERMIN_SEL EQU 0
WaveDAC8_1_Wave2_DMA__TERMOUT0_EN EQU 0
WaveDAC8_1_Wave2_DMA__TERMOUT0_SEL EQU 0
WaveDAC8_1_Wave2_DMA__TERMOUT1_EN EQU 0
WaveDAC8_1_Wave2_DMA__TERMOUT1_SEL EQU 0

; Miscellaneous
BCLK__BUS_CLK__HZ EQU 24000000
BCLK__BUS_CLK__KHZ EQU 24000
BCLK__BUS_CLK__MHZ EQU 24
CYDEV_CHIP_DIE_LEOPARD EQU 1
CYDEV_CHIP_DIE_PANTHER EQU 18
CYDEV_CHIP_DIE_PSOC4A EQU 10
CYDEV_CHIP_DIE_PSOC5LP EQU 17
CYDEV_CHIP_DIE_TMA4 EQU 2
CYDEV_CHIP_DIE_UNKNOWN EQU 0
CYDEV_CHIP_FAMILY_PSOC3 EQU 1
CYDEV_CHIP_FAMILY_PSOC4 EQU 2
CYDEV_CHIP_FAMILY_PSOC5 EQU 3
CYDEV_CHIP_FAMILY_UNKNOWN EQU 0
CYDEV_CHIP_FAMILY_USED EQU CYDEV_CHIP_FAMILY_PSOC5
CYDEV_CHIP_JTAG_ID EQU 0x2E160069
CYDEV_CHIP_MEMBER_3A EQU 1
CYDEV_CHIP_MEMBER_4A EQU 10
CYDEV_CHIP_MEMBER_4C EQU 15
CYDEV_CHIP_MEMBER_4D EQU 6
CYDEV_CHIP_MEMBER_4E EQU 4
CYDEV_CHIP_MEMBER_4F EQU 11
CYDEV_CHIP_MEMBER_4G EQU 2
CYDEV_CHIP_MEMBER_4H EQU 9
CYDEV_CHIP_MEMBER_4I EQU 14
CYDEV_CHIP_MEMBER_4J EQU 7
CYDEV_CHIP_MEMBER_4K EQU 8
CYDEV_CHIP_MEMBER_4L EQU 13
CYDEV_CHIP_MEMBER_4M EQU 12
CYDEV_CHIP_MEMBER_4N EQU 5
CYDEV_CHIP_MEMBER_4U EQU 3
CYDEV_CHIP_MEMBER_5A EQU 17
CYDEV_CHIP_MEMBER_5B EQU 16
CYDEV_CHIP_MEMBER_UNKNOWN EQU 0
CYDEV_CHIP_MEMBER_USED EQU CYDEV_CHIP_MEMBER_5B
CYDEV_CHIP_DIE_EXPECT EQU CYDEV_CHIP_MEMBER_USED
CYDEV_CHIP_DIE_ACTUAL EQU CYDEV_CHIP_DIE_EXPECT
CYDEV_CHIP_REV_LEOPARD_ES1 EQU 0
CYDEV_CHIP_REV_LEOPARD_ES2 EQU 1
CYDEV_CHIP_REV_LEOPARD_ES3 EQU 3
CYDEV_CHIP_REV_LEOPARD_PRODUCTION EQU 3
CYDEV_CHIP_REV_PANTHER_ES0 EQU 0
CYDEV_CHIP_REV_PANTHER_ES1 EQU 1
CYDEV_CHIP_REV_PANTHER_PRODUCTION EQU 1
CYDEV_CHIP_REV_PSOC4A_ES0 EQU 17
CYDEV_CHIP_REV_PSOC4A_PRODUCTION EQU 17
CYDEV_CHIP_REV_PSOC5LP_ES0 EQU 0
CYDEV_CHIP_REV_PSOC5LP_PRODUCTION EQU 0
CYDEV_CHIP_REV_TMA4_ES EQU 17
CYDEV_CHIP_REV_TMA4_ES2 EQU 33
CYDEV_CHIP_REV_TMA4_PRODUCTION EQU 17
CYDEV_CHIP_REVISION_3A_ES1 EQU 0
CYDEV_CHIP_REVISION_3A_ES2 EQU 1
CYDEV_CHIP_REVISION_3A_ES3 EQU 3
CYDEV_CHIP_REVISION_3A_PRODUCTION EQU 3
CYDEV_CHIP_REVISION_4A_ES0 EQU 17
CYDEV_CHIP_REVISION_4A_PRODUCTION EQU 17
CYDEV_CHIP_REVISION_4C_PRODUCTION EQU 0
CYDEV_CHIP_REVISION_4D_PRODUCTION EQU 0
CYDEV_CHIP_REVISION_4E_PRODUCTION EQU 0
CYDEV_CHIP_REVISION_4F_PRODUCTION EQU 0
CYDEV_CHIP_REVISION_4F_PRODUCTION_256DMA EQU 0
CYDEV_CHIP_REVISION_4F_PRODUCTION_256K EQU 0
CYDEV_CHIP_REVISION_4G_ES EQU 17
CYDEV_CHIP_REVISION_4G_ES2 EQU 33
CYDEV_CHIP_REVISION_4G_PRODUCTION EQU 17
CYDEV_CHIP_REVISION_4H_PRODUCTION EQU 0
CYDEV_CHIP_REVISION_4I_PRODUCTION EQU 0
CYDEV_CHIP_REVISION_4J_PRODUCTION EQU 0
CYDEV_CHIP_REVISION_4K_PRODUCTION EQU 0
CYDEV_CHIP_REVISION_4L_PRODUCTION EQU 0
CYDEV_CHIP_REVISION_4M_PRODUCTION EQU 0
CYDEV_CHIP_REVISION_4N_PRODUCTION EQU 0
CYDEV_CHIP_REVISION_4U_PRODUCTION EQU 0
CYDEV_CHIP_REVISION_5A_ES0 EQU 0
CYDEV_CHIP_REVISION_5A_ES1 EQU 1
CYDEV_CHIP_REVISION_5A_PRODUCTION EQU 1
CYDEV_CHIP_REVISION_5B_ES0 EQU 0
CYDEV_CHIP_REVISION_5B_PRODUCTION EQU 0
CYDEV_CHIP_REVISION_USED EQU CYDEV_CHIP_REVISION_5B_PRODUCTION
CYDEV_CHIP_REV_EXPECT EQU CYDEV_CHIP_REVISION_USED
CYDEV_CONFIG_FASTBOOT_ENABLED EQU 1
CYDEV_CONFIG_UNUSED_IO_AllowButWarn EQU 0
CYDEV_CONFIG_UNUSED_IO EQU CYDEV_CONFIG_UNUSED_IO_AllowButWarn
CYDEV_CONFIG_UNUSED_IO_AllowWithInfo EQU 1
CYDEV_CONFIG_UNUSED_IO_Disallowed EQU 2
CYDEV_CONFIGURATION_COMPRESSED EQU 1
CYDEV_CONFIGURATION_DMA EQU 0
CYDEV_CONFIGURATION_ECC EQU 1
CYDEV_CONFIGURATION_IMOENABLED EQU CYDEV_CONFIG_FASTBOOT_ENABLED
CYDEV_CONFIGURATION_MODE_COMPRESSED EQU 0
CYDEV_CONFIGURATION_MODE EQU CYDEV_CONFIGURATION_MODE_COMPRESSED
CYDEV_CONFIGURATION_MODE_DMA EQU 2
CYDEV_CONFIGURATION_MODE_UNCOMPRESSED EQU 1
CYDEV_DEBUG_ENABLE_MASK EQU 0x20
CYDEV_DEBUG_ENABLE_REGISTER EQU CYREG_MLOGIC_DEBUG
CYDEV_DEBUGGING_DPS_Disable EQU 3
CYDEV_DEBUGGING_DPS_JTAG_4 EQU 1
CYDEV_DEBUGGING_DPS_JTAG_5 EQU 0
CYDEV_DEBUGGING_DPS_SWD EQU 2
CYDEV_DEBUGGING_DPS_SWD_SWV EQU 6
CYDEV_DEBUGGING_DPS EQU CYDEV_DEBUGGING_DPS_SWD_SWV
CYDEV_DEBUGGING_ENABLE EQU 1
CYDEV_DEBUGGING_XRES EQU 0
CYDEV_DMA_CHANNELS_AVAILABLE EQU 24
CYDEV_ECC_ENABLE EQU 0
CYDEV_HEAP_SIZE EQU 0x80
CYDEV_INSTRUCT_CACHE_ENABLED EQU 1
CYDEV_INTR_RISING EQU 0x00000001
CYDEV_IS_EXPORTING_CODE EQU 0
CYDEV_IS_IMPORTING_CODE EQU 0
CYDEV_PROJ_TYPE EQU 0
CYDEV_PROJ_TYPE_BOOTLOADER EQU 1
CYDEV_PROJ_TYPE_LAUNCHER EQU 5
CYDEV_PROJ_TYPE_LOADABLE EQU 2
CYDEV_PROJ_TYPE_LOADABLEANDBOOTLOADER EQU 4
CYDEV_PROJ_TYPE_MULTIAPPBOOTLOADER EQU 3
CYDEV_PROJ_TYPE_STANDARD EQU 0
CYDEV_PROTECTION_ENABLE EQU 0
CYDEV_STACK_SIZE EQU 0x0800
CYDEV_USE_BUNDLED_CMSIS EQU 1
CYDEV_VARIABLE_VDDA EQU 0
CYDEV_VDDA_MV EQU 5000
CYDEV_VDDD_MV EQU 5000
CYDEV_VDDIO0_MV EQU 5000
CYDEV_VDDIO1_MV EQU 5000
CYDEV_VDDIO2_MV EQU 5000
CYDEV_VDDIO3_MV EQU 5000
CYDEV_VIO0_MV EQU 5000
CYDEV_VIO1_MV EQU 5000
CYDEV_VIO2_MV EQU 5000
CYDEV_VIO3_MV EQU 5000
CYIPBLOCK_ARM_CM3_VERSION EQU 0
CYIPBLOCK_P3_ANAIF_VERSION EQU 0
CYIPBLOCK_P3_CAN_VERSION EQU 0
CYIPBLOCK_P3_CAPSENSE_VERSION EQU 0
CYIPBLOCK_P3_COMP_VERSION EQU 0
CYIPBLOCK_P3_DECIMATOR_VERSION EQU 0
CYIPBLOCK_P3_DFB_VERSION EQU 0
CYIPBLOCK_P3_DMA_VERSION EQU 0
CYIPBLOCK_P3_DRQ_VERSION EQU 0
CYIPBLOCK_P3_DSM_VERSION EQU 0
CYIPBLOCK_P3_EMIF_VERSION EQU 0
CYIPBLOCK_P3_I2C_VERSION EQU 0
CYIPBLOCK_P3_LCD_VERSION EQU 0
CYIPBLOCK_P3_LPF_VERSION EQU 0
CYIPBLOCK_P3_OPAMP_VERSION EQU 0
CYIPBLOCK_P3_PM_VERSION EQU 0
CYIPBLOCK_P3_SCCT_VERSION EQU 0
CYIPBLOCK_P3_TIMER_VERSION EQU 0
CYIPBLOCK_P3_USB_VERSION EQU 0
CYIPBLOCK_P3_VIDAC_VERSION EQU 0
CYIPBLOCK_P3_VREF_VERSION EQU 0
CYIPBLOCK_S8_GPIO_VERSION EQU 0
CYIPBLOCK_S8_IRQ_VERSION EQU 0
CYIPBLOCK_S8_SAR_VERSION EQU 0
CYIPBLOCK_S8_SIO_VERSION EQU 0
CYIPBLOCK_S8_UDB_VERSION EQU 0
Dedicated_Output__INTTYPE EQU CYREG_PICU0_INTTYPE1
Dedicated_Output__MASK EQU 0x02
Dedicated_Output__PC EQU CYREG_PRT0_PC1
Dedicated_Output__PORT EQU 0
Dedicated_Output__SHIFT EQU 1
Dedicated_Output_1__INTTYPE EQU CYREG_PICU3_INTTYPE7
Dedicated_Output_1__MASK EQU 0x80
Dedicated_Output_1__PC EQU CYREG_PRT3_PC7
Dedicated_Output_1__PORT EQU 3
Dedicated_Output_1__SHIFT EQU 7
DMA_CHANNELS_USED__MASK0 EQU 0x00000003
CYDEV_BOOTLOADER_ENABLE EQU 0
    ENDIF
    END
